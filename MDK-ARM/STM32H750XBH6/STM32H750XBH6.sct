; *************************************************************
; *** Scatter-Loading Description File generated by uVision ***
; *************************************************************

LR_ROM1 0x90000000 0x02000000  {    ; load region size_region
  ER_ROM1 0x90000000 0x02000000  {  ; load address = execution address
   *.o (RESET, +First)
   *(InRoot$$Sections)
   .ANY (+RO)
   .ANY (+XO)
  }
  RW_IRAM1 0x20000000 0x00020000  {  ; RW data
   .ANY (+RW +ZI)
  }
  RW_RAM1 0x30000000 0x00048000  {
    lv_disp.o (+RO)
    lv_event.o (+RO)
    lv_group.o (+RO)
    lv_indev.o (+RO)
    lv_indev_scroll.o (+RO)
    lv_obj.o (+RO)
    lv_obj_class.o (+RO)
    lv_obj_draw.o (+RO)
    lv_obj_pos.o (+RO)
    lv_obj_scroll.o (+RO)
    lv_obj_style.o (+RO)
    lv_obj_style_gen.o (+RO)
    lv_obj_tree.o (+RO)
    lv_refr.o (+RO)
    lv_theme.o (+RO)
    lv_draw.o (+RO)
    lv_draw_arc.o (+RO)
    lv_draw_img.o (+RO)
    lv_draw_label.o (+RO)
    lv_draw_layer.o (+RO)
    lv_draw_line.o (+RO)
    lv_draw_mask.o (+RO)
    lv_draw_rect.o (+RO)
    lv_draw_transform.o (+RO)

    lv_img_buf.o (+RO)
    lv_img_cache.o (+RO)
    lv_img_decoder.o (+RO)





























    lv_draw_sw.o (+RO)
    lv_draw_sw_arc.o (+RO)
    lv_draw_sw_blend.o (+RO)

    lv_draw_sw_gradient.o (+RO)
    lv_draw_sw_img.o (+RO)
    lv_draw_sw_layer.o (+RO)
    lv_draw_sw_letter.o (+RO)
    lv_draw_sw_line.o (+RO)
    lv_draw_sw_polygon.o (+RO)
    lv_draw_sw_rect.o (+RO)
    lv_draw_sw_transform.o (+RO)

    lv_flex.o (+RO)
    lv_grid.o (+RO)



























    lv_theme_default.o (+RO)


    lv_calendar.o (+RO)
    lv_calendar_header_arrow.o (+RO)
    lv_calendar_header_dropdown.o (+RO)
    lv_chart.o (+RO)
    lv_colorwheel.o (+RO)

    lv_keyboard.o (+RO)
    lv_led.o (+RO)
    lv_list.o (+RO)
    lv_menu.o (+RO)
    lv_meter.o (+RO)
    lv_msgbox.o (+RO)

    lv_spinbox.o (+RO)
    lv_spinner.o (+RO)
    lv_tabview.o (+RO)
    lv_tileview.o (+RO)
    lv_win.o (+RO)
    lv_extra.o (+RO)
    lv_font.o (+RO)

    lv_font_fmt_txt.o (+RO)



























    lv_hal_disp.o (+RO)
    lv_hal_indev.o (+RO)
    lv_hal_tick.o (+RO)
    lv_anim.o (+RO)

    lv_area.o (+RO)


    lv_color.o (+RO)
    lv_fs.o (+RO)

    lv_ll.o (+RO)


    lv_math.o (+RO)
    lv_mem.o (+RO)
    lv_printf.o (+RO)
    lv_style.o (+RO)
    lv_style_gen.o (+RO)

    lv_timer.o (+RO)
    lv_tlsf.o (+RO)
    lv_txt.o (+RO)

    lv_utils.o (+RO)
    lv_arc.o (+RO)
    lv_bar.o (+RO)
    lv_btn.o (+RO)
    lv_btnmatrix.o (+RO)

    lv_checkbox.o (+RO)
    lv_dropdown.o (+RO)
    lv_img.o (+RO)
    lv_label.o (+RO)
    lv_line.o (+RO)

    lv_roller.o (+RO)
    lv_slider.o (+RO)
    lv_switch.o (+RO)
    lv_table.o (+RO)
    lv_textarea.o (+RO)
  }
  RW_IRAM2 0x24000000 0x00080000  {
   .ANY (+RW +ZI)
  }
}

